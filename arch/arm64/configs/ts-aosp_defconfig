## arch/arm64/configs/ts-aosp_defconfig
```kconfig
#
# AOSP Port settings
#
# CONFIG_WLAN_GRACE is not set
# CONFIG_CAMERA_HERO is not set
CONFIG_CAMERA_GRACE=y
CONFIG_GRACE_PERIOD=y
CONFIG_HARDENED_USERCOPY=y
CONFIG_SUNRPC=y
CONFIG_SUNRPC_GSS=y
# CONFIG_SUNRPC_DEBUG is not set
# CONFIG_F2FS_FS_POSIX_ACL is not set
CONFIG_BCMDHD_FW_PATH="/vendor/etc/wifi/bcmdhd_sta.bin"
CONFIG_BCMDHD_NVRAM_PATH="/vendor/etc/wifi/nvram_net.txt"
CONFIG_DDK_VERSION_OS="q"
# CONFIG_MALI_R22P0 is not set
# CONFIG_MALI_R28P0 is not set
CONFIG_MALI_R29P0=y
# CONFIG_PM_WAKELOCKS_SENSOR_IND_HACK is not set
CONFIG_USB_ANDROID_SAMSUNG_MTP is not set
CONFIG_NETFILTER_XT_TARGET_CT=y
CONFIG_ALWAYS_PERMISSIVE=y
```

## arch/arm64/configs/ts-oreo_defconfig
```kconfig
#
# OREO settings
#
# CONFIG_WLAN_GRACE is not set
CONFIG_CAMERA_HERO=y
# CONFIG_CAMERA_GRACE is not set
##CONFIG_DDK_VERSION_OS="o"
##CONFIG_MALI_R22P0=y
## CONFIG_MALI_R28P0 is not set

CONFIG_DDK_VERSION_OS="q"
# CONFIG_MALI_R22P0 is not set
# CONFIG_MALI_R28P0 is not set
CONFIG_MALI_R29P0=y

CONFIG_ALWAYS_PERMISSIVE=y
CONFIG_USB_ANDROID_SAMSUNG_MTP=y
CONFIG_NETFILTER_XT_TARGET_CT=y

# CONFIG_HALL_EVENT_REVERSE is not set
```

## arch/arm64/configs/ts-pie_defconfig
```kconfig
#
# PIE Port settings
#
CONFIG_WLAN_GRACE=y
# CONFIG_CAMERA_HERO is not set
CONFIG_CAMERA_GRACE=y
CONFIG_DDK_VERSION_OS="q"
# CONFIG_MALI_R22P0 is not set
# CONFIG_MALI_R28P0 is not set
CONFIG_MALI_R29P0=y
CONFIG_SECURITY_SELINUX_FAKE_ENFORCE=y
# CONFIG_SECURITY_SELINUX_ALWAYS_ENFORCE is not set
# CONFIG_SECURITY_SELINUX_NEVER_ENFORCE is not set
```

## arch/arm64/configs/ts-q_defconfig
```kconfig
#
# OneUI Q Port settings
#
CONFIG_WLAN_GRACE=y
# CONFIG_CAMERA_HERO is not set
CONFIG_CAMERA_GRACE=y
CONFIG_GRACE_PERIOD=y
## CONFIG_ASSISTED_SUPERUSER is not set
CONFIG_ALWAYS_PERMISSIVE=y
CONFIG_DDK_VERSION_OS="q"
# CONFIG_MALI_R22P0 is not set
# CONFIG_MALI_R28P0 is not set
CONFIG_MALI_R29P0=y
CONFIG_NETFILTER_XT_TARGET_CT=y
CONFIG_USB_ANDROID_SAMSUNG_MTP=y
```

## arch/arm64/configs/ts-treble_defconfig
```kconfig
#
# Treble Port settings
#
CONFIG_WLAN_GRACE=y
# CONFIG_CAMERA_HERO is not set
CONFIG_CAMERA_GRACE=y
CONFIG_DDK_VERSION_OS="q"
# CONFIG_MALI_R22P0 is not set
# CONFIG_MALI_R28P0 is not set
CONFIG_MALI_R29P0=y
CONFIG_ALWAYS_PERMISSIVE=y
CONFIG_PM_WAKELOCKS_SENSOR_IND_HACK=y
CONFIG_NETFILTER_XT_TARGET_CT=y
```
